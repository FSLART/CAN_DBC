VERSION ""

NS_ :

BS_:

BU_: JETSON VCU ACU RES

BO_ 81 ACU_MS: 8 ACU
 SG_ Mission_Select : 0|8@1+ (1,0) [0|0] "" Vector__XXX

BO_ 97 JETSON_MS: 8 JETSON
 SG_ Mission_Select : 0|8@1+ (1,0) [0|0] "" Vector__XXX

BO_ 1296 VCU_RPM: 8 VCU
 SG_ RPM : 0|16@1+ (1,0) [0|0] "" Vector__XXX

BO_ 1280 Target_RPM: 8 JETSON
 SG_ RPM : 0|16@1+ (1,0) [0|0] "" Vector__XXX

BO_ 113 ACU_IGN: 8 ACU
 SG_ IGN : 0|8@1+ (1,0) [0|0] "" Vector__XXX

BO_ 1298 RD_JETSON: 8 ACU
 SG_ RD : 0|8@1+ (1,0) [0|0] "" Vector__XXX

BO_ 1282 AS_STATE: 8 JETSON
 SG_ STATE : 0|8@1+ (1,0) [0|0] "" Vector__XXX

BO_ 129 VCU_HV: 8 Vector__XXX
 SG_ HV : 0|8@1+ (1,0) [0|0] "" Vector__XXX
